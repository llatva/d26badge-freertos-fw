## sdkconfig.defaults
```kconfig
# Target board: ESP32-S3-WROOM-2 (16MB Flash, 8MB PSRAM)
CONFIG_IDF_TARGET="esp32s3"

# CPU speed
CONFIG_ESP_DEFAULT_CPU_FREQ_MHZ_240=y

# Flash size: 16MB for ESP32-S3-WROOM-2
CONFIG_ESPTOOLPY_FLASHSIZE_16MB=y

# PSRAM: Disabled for now due to bootloader instability with Octal flash
# CONFIG_SPIRAM is not set

# Custom partition table with OTA + MicroPython support
CONFIG_PARTITION_TABLE_CUSTOM=y
CONFIG_PARTITION_TABLE_CUSTOM_FILENAME="partitions_ota_micropython.csv"

# FAT filesystem for Python apps
CONFIG_FATFS_LFN_HEAP=y
CONFIG_FATFS_MAX_LFN=255

# Pin the app to CPU0; keep CPU1 free for future MicroPython
CONFIG_FREERTOS_UNICORE=n
CONFIG_ESP_MAIN_TASK_AFFINITY_CPU0=y

# FreeRTOS tick rate (1 ms)
CONFIG_FREERTOS_HZ=1000

# Enough stack for idf_main and tasks
CONFIG_ESP_MAIN_TASK_STACK_SIZE=8192

# Logging
CONFIG_LOG_DEFAULT_LEVEL_INFO=y

# SPI: keep ISR out of IRAM to save space (IRAM is tight with MicroPython)
# CONFIG_SPI_MASTER_IN_IRAM is not set

# RMT (for SK6812 LEDs) - keep out of IRAM to save space
CONFIG_RMT_RECV_FUNC_IN_IRAM=n

# Task watchdog: don't check CPU1 idle task (MicroPython owns CPU1)
# CONFIG_ESP_TASK_WDT_CHECK_IDLE_TASK_CPU1 is not set

# Memory protection: disable because IRAM/DRAM boundary is very tight
# with MicroPython core linked in; PMS can't establish proper split
# CONFIG_ESP_SYSTEM_MEMPROT_FEATURE is not set

# USB-JTAG / Serial monitor
CONFIG_ESP_CONSOLE_USB_SERIAL_JTAG=y
```
